/******************************************************************************
* ASAP2 file: HANcoder_Olimexino_F3_ACC.a2l
* Academic License - for use in teaching, academic research, and meeting
* course requirements at degree granting institutions only. Not for
* government, commercial, or other organizational use.
* Code generation for model "HANcoder_Olimexino_F3_ACC".
* Model version : 1.2
* Simulink Coder version : 9.9 (R2023a) 19-Nov-2022
* C source code generated on : Thu Jun 8 16:32:35 2023
* Target selection: ert.tlc
* Embedded hardware selection: ARM Compatible->ARM Cortex
* Code generation objectives: Unspecified
* Validation result: Not run
* (add additional file header information here)
******************************************************************************/ ASAP2_VERSION 1 31
/* Version 1.31 */
/begin PROJECT ProjectName "Project Comment Goes Here"
/begin HEADER "Header Comments go here" /end HEADER
/begin MODULE ModuleName "Module Comment Goes Here"
/begin MOD_PAR "MOD PAR Comment Goes Here" ADDR_EPK 0x2000001c CPU_TYPE "STM32F103" ECU "Olimexino" EPK "HANcoder_Olimexino_F3_ACC_softwareID_v1_080623_163221"
 SYSTEM_CONSTANT "XcpStationID string length" "0x00000036"
 SYSTEM_CONSTANT "RAM-FlashOffset" "-402586080" /end MOD_PAR
/begin MOD_COMMON "Mod Common Comment Here" BYTE_ORDER MSB_LAST /end MOD_COMMON
/begin RECORD_LAYOUT Scalar_BOOLEAN FNC_VALUES 1 UBYTE COLUMN_DIR DIRECT /end RECORD_LAYOUT
/begin RECORD_LAYOUT Scalar_UBYTE FNC_VALUES 1 UBYTE COLUMN_DIR DIRECT /end RECORD_LAYOUT
/begin RECORD_LAYOUT Scalar_BYTE FNC_VALUES 1 SBYTE COLUMN_DIR DIRECT /end RECORD_LAYOUT
/begin RECORD_LAYOUT Scalar_UWORD FNC_VALUES 1 UWORD COLUMN_DIR DIRECT /end RECORD_LAYOUT
/begin RECORD_LAYOUT Scalar_SWORD FNC_VALUES 1 SWORD COLUMN_DIR DIRECT /end RECORD_LAYOUT
/begin RECORD_LAYOUT Scalar_ULONG FNC_VALUES 1 ULONG COLUMN_DIR DIRECT /end RECORD_LAYOUT
/begin RECORD_LAYOUT Scalar_LONG FNC_VALUES 1 SLONG COLUMN_DIR DIRECT /end RECORD_LAYOUT
/begin RECORD_LAYOUT Scalar_FLOAT32_IEEE FNC_VALUES 1 FLOAT32_IEEE COLUMN_DIR DIRECT /end RECORD_LAYOUT
/begin RECORD_LAYOUT Scalar_FLOAT64_IEEE FNC_VALUES 1 FLOAT64_IEEE COLUMN_DIR DIRECT /end RECORD_LAYOUT
/begin RECORD_LAYOUT Lookup1D_BOOLEAN FNC_VALUES 1 UBYTE COLUMN_DIR DIRECT /end RECORD_LAYOUT
/begin RECORD_LAYOUT Lookup1D_X_BOOLEAN AXIS_PTS_X 1 UBYTE INDEX_INCR DIRECT /end RECORD_LAYOUT
/begin RECORD_LAYOUT Lookup1D_BYTE FNC_VALUES 1 SBYTE COLUMN_DIR DIRECT /end RECORD_LAYOUT
/begin RECORD_LAYOUT Lookup1D_X_BYTE AXIS_PTS_X 1 SBYTE INDEX_INCR DIRECT /end RECORD_LAYOUT
/begin RECORD_LAYOUT Lookup1D_UBYTE FNC_VALUES 1 UBYTE COLUMN_DIR DIRECT /end RECORD_LAYOUT
/begin RECORD_LAYOUT Lookup1D_X_UBYTE AXIS_PTS_X 1 UBYTE INDEX_INCR DIRECT /end RECORD_LAYOUT
/begin RECORD_LAYOUT Lookup1D_UWORD FNC_VALUES 1 UWORD COLUMN_DIR DIRECT /end RECORD_LAYOUT
/begin RECORD_LAYOUT Lookup1D_X_UWORD AXIS_PTS_X 1 UWORD INDEX_INCR DIRECT /end RECORD_LAYOUT
/begin RECORD_LAYOUT Lookup1D_WORD FNC_VALUES 1 SWORD COLUMN_DIR DIRECT /end RECORD_LAYOUT
/begin RECORD_LAYOUT Lookup1D_X_WORD AXIS_PTS_X 1 SWORD INDEX_INCR DIRECT /end RECORD_LAYOUT
/begin RECORD_LAYOUT Lookup1D_ULONG FNC_VALUES 1 ULONG COLUMN_DIR DIRECT /end RECORD_LAYOUT
/begin RECORD_LAYOUT Lookup1D_X_ULONG AXIS_PTS_X 1 ULONG INDEX_INCR DIRECT /end RECORD_LAYOUT
/begin RECORD_LAYOUT Lookup1D_SLONG FNC_VALUES 1 SLONG COLUMN_DIR DIRECT /end RECORD_LAYOUT
/begin RECORD_LAYOUT Lookup1D_X_LONG AXIS_PTS_X 1 SLONG INDEX_INCR DIRECT /end RECORD_LAYOUT
/begin RECORD_LAYOUT Lookup1D_FLOAT32_IEEE FNC_VALUES 1 FLOAT32_IEEE COLUMN_DIR DIRECT /end RECORD_LAYOUT
/begin RECORD_LAYOUT Lookup1D_X_FLOAT32_IEEE AXIS_PTS_X 1 FLOAT32_IEEE INDEX_INCR DIRECT /end RECORD_LAYOUT
/begin RECORD_LAYOUT Lookup1D_FLOAT64_IEEE FNC_VALUES 1 FLOAT64_IEEE COLUMN_DIR DIRECT /end RECORD_LAYOUT
/begin RECORD_LAYOUT Lookup1D_X_FLOAT64_IEEE AXIS_PTS_X 1 FLOAT64_IEEE INDEX_INCR DIRECT /end RECORD_LAYOUT
/begin RECORD_LAYOUT Lookup2D_BOOLEAN FNC_VALUES 1 UBYTE COLUMN_DIR DIRECT /end RECORD_LAYOUT
/begin RECORD_LAYOUT Lookup2D_X_BOOLEAN AXIS_PTS_X 1 UBYTE INDEX_INCR DIRECT /end RECORD_LAYOUT
/begin RECORD_LAYOUT Lookup2D_UBYTE FNC_VALUES 1 UBYTE COLUMN_DIR DIRECT /end RECORD_LAYOUT
/begin RECORD_LAYOUT Lookup2D_X_UBYTE AXIS_PTS_X 1 UBYTE INDEX_INCR DIRECT /end RECORD_LAYOUT
/begin RECORD_LAYOUT Lookup2D_BYTE FNC_VALUES 1 SBYTE COLUMN_DIR DIRECT /end RECORD_LAYOUT
/begin RECORD_LAYOUT Lookup2D_X_BYTE AXIS_PTS_X 1 SBYTE INDEX_INCR DIRECT /end RECORD_LAYOUT
/begin RECORD_LAYOUT Lookup2D_UWORD FNC_VALUES 1 UWORD COLUMN_DIR DIRECT /end RECORD_LAYOUT
/begin RECORD_LAYOUT Lookup2D_X_UWORD AXIS_PTS_X 1 UWORD INDEX_INCR DIRECT /end RECORD_LAYOUT
/begin RECORD_LAYOUT Lookup2D_WORD FNC_VALUES 1 SWORD COLUMN_DIR DIRECT /end RECORD_LAYOUT
/begin RECORD_LAYOUT Lookup2D_X_WORD AXIS_PTS_X 1 SWORD INDEX_INCR DIRECT /end RECORD_LAYOUT
/begin RECORD_LAYOUT Lookup2D_ULONG FNC_VALUES 1 ULONG COLUMN_DIR DIRECT /end RECORD_LAYOUT
/begin RECORD_LAYOUT Lookup2D_X_ULONG AXIS_PTS_X 1 ULONG INDEX_INCR DIRECT /end RECORD_LAYOUT
/begin RECORD_LAYOUT Lookup2D_LONG FNC_VALUES 1 SLONG COLUMN_DIR DIRECT /end RECORD_LAYOUT
/begin RECORD_LAYOUT Lookup2D_X_LONG AXIS_PTS_X 1 SLONG INDEX_INCR DIRECT /end RECORD_LAYOUT
/begin RECORD_LAYOUT Lookup2D_FLOAT32_IEEE FNC_VALUES 1 FLOAT32_IEEE COLUMN_DIR DIRECT /end RECORD_LAYOUT
/begin RECORD_LAYOUT Lookup2D_X_FLOAT32_IEEE AXIS_PTS_X 1 FLOAT32_IEEE INDEX_INCR DIRECT /end RECORD_LAYOUT
/begin RECORD_LAYOUT Lookup2D_FLOAT64_IEEE FNC_VALUES 1 FLOAT64_IEEE COLUMN_DIR DIRECT /end RECORD_LAYOUT
/begin RECORD_LAYOUT Lookup2D_X_FLOAT64_IEEE AXIS_PTS_X 1 FLOAT64_IEEE INDEX_INCR DIRECT /end RECORD_LAYOUT
/begin MEASUREMENT Sim_dist "" FLOAT64_IEEE HANcoder_Olimexino_F3_ACC_CM_double 0 0 -1.7E+308 1.7E+308 ECU_ADDRESS 0x200001f8 /end MEASUREMENT
/begin MEASUREMENT own_dist "" FLOAT64_IEEE HANcoder_Olimexino_F3_ACC_CM_double 0 0 -1.7E+308 1.7E+308 ECU_ADDRESS 0x20000228 /end MEASUREMENT
/begin MEASUREMENT Sim_GAP "" FLOAT64_IEEE HANcoder_Olimexino_F3_ACC_CM_double 0 0 -1.7E+308 1.7E+308 ECU_ADDRESS 0x200001f0 /end MEASUREMENT
/begin MEASUREMENT E "" FLOAT64_IEEE HANcoder_Olimexino_F3_ACC_CM_double 0 0 -1.7E+308 1.7E+308 ECU_ADDRESS 0x200001d8 /end MEASUREMENT
/begin MEASUREMENT switcher "" FLOAT64_IEEE HANcoder_Olimexino_F3_ACC_CM_double 0 0 -1.7E+308 1.7E+308 ECU_ADDRESS 0x20000320 /end MEASUREMENT
/begin MEASUREMENT Speed_setpoint "" FLOAT64_IEEE HANcoder_Olimexino_F3_ACC_CM_double 0 0 -1.7E+308 1.7E+308 ECU_ADDRESS 0x20000200 /end MEASUREMENT
/begin MEASUREMENT speed_Right "" FLOAT64_IEEE HANcoder_Olimexino_F3_ACC_CM_double 0 0 -1.7E+308 1.7E+308 ECU_ADDRESS 0x20000310 /end MEASUREMENT
/begin MEASUREMENT SI_FreeHeap "" ULONG HANcoder_Olimexino_F3_ACC_CM_uint32 0 0 0 4294967295 ECU_ADDRESS 0x200001e4 /end MEASUREMENT
/begin MEASUREMENT SI_FreeStack "" ULONG HANcoder_Olimexino_F3_ACC_CM_uint32 0 0 0 4294967295 ECU_ADDRESS 0x200001e8 /end MEASUREMENT
/begin MEASUREMENT control_effort "" UWORD HANcoder_Olimexino_F3_ACC_CM_uint16 0 0 0 65535 ECU_ADDRESS 0x2000021e /end MEASUREMENT
/begin MEASUREMENT camera_gap "" SWORD HANcoder_Olimexino_F3_ACC_CM_int16 0 0 -32768 32767 ECU_ADDRESS 0x20000208 /end MEASUREMENT
/begin MEASUREMENT speed_setpoint "" SWORD HANcoder_Olimexino_F3_ACC_CM_int16 0 0 -32768 32767 ECU_ADDRESS 0x20000318 /end MEASUREMENT
/begin MEASUREMENT Distance_setpoint "" SWORD HANcoder_Olimexino_F3_ACC_CM_int16 0 0 -32768 32767 ECU_ADDRESS 0x200001d6 /end MEASUREMENT
/begin MEASUREMENT gap_valid "" SWORD HANcoder_Olimexino_F3_ACC_CM_int16 0 0 -32768 32767 ECU_ADDRESS 0x20000220 /end MEASUREMENT
/begin MEASUREMENT SI_CPUload "" UBYTE HANcoder_Olimexino_F3_ACC_CM_uint8 0 0 0 255 ECU_ADDRESS 0x200001e1 /end MEASUREMENT
/begin MEASUREMENT ON_OFF "" UBYTE HANcoder_Olimexino_F3_ACC_CM_boolean 0 0 0 1 ECU_ADDRESS 0x200001e0 /end MEASUREMENT
/begin MEASUREMENT cc_acc_switcher "" UBYTE HANcoder_Olimexino_F3_ACC_CM_boolean 0 0 0 1 ECU_ADDRESS 0x2000021c /end MEASUREMENT
/begin COMPU_METHOD HANcoder_Olimexino_F3_ACC_CM_double "Q = V" RAT_FUNC "%15.10" "" COEFFS 0 1 0 0 0 1 /end COMPU_METHOD
/begin COMPU_METHOD HANcoder_Olimexino_F3_ACC_CM_uint32 "Q = V" RAT_FUNC "%10.0" "" COEFFS 0 1 0 0 0 1 /end COMPU_METHOD
/begin COMPU_METHOD HANcoder_Olimexino_F3_ACC_CM_uint16 "Q = V" RAT_FUNC "%5.0" "" COEFFS 0 1 0 0 0 1 /end COMPU_METHOD
/begin COMPU_METHOD HANcoder_Olimexino_F3_ACC_CM_int16 "Q = V" RAT_FUNC "%5.0" "" COEFFS 0 1 0 0 0 1 /end COMPU_METHOD
/begin COMPU_METHOD HANcoder_Olimexino_F3_ACC_CM_uint8 "Q = V" RAT_FUNC "%3.0" "" COEFFS 0 1 0 0 0 1 /end COMPU_METHOD
/begin COMPU_METHOD HANcoder_Olimexino_F3_ACC_CM_boolean "Q = V" RAT_FUNC "%1.0" "" COEFFS 0 1 0 0 0 1 /end COMPU_METHOD
/begin GROUP HANcoder_Olimexino_F3_ACC "HANcoder_Olimexino_F3_ACC" /* Root */ ROOT /begin SUB_GROUP Root_HANcoder_STM32_Target___Olimexino_STM32_F3_algorithm /end SUB_GROUP /end GROUP
/begin GROUP Root_HANcoder_STM32_Target___Olimexino_STM32_F3_algorithm "HANcoder_Olimexino_F3_ACC/HANcoder STM32 Target - Olimexino-STM32 F3 algorithm" /begin SUB_GROUP S1_Subsystem S1_Sytem_information /end SUB_GROUP /begin REF_MEASUREMENT ON_OFF /end REF_MEASUREMENT /end GROUP
/begin GROUP S1_Subsystem "HANcoder_Olimexino_F3_ACC/HANcoder STM32 Target - Olimexino-STM32 F3 algorithm/Subsystem" /begin SUB_GROUP S7_Algorithm S7_Inputs /end SUB_GROUP /end GROUP
/begin GROUP S1_Sytem_information "HANcoder_Olimexino_F3_ACC/HANcoder STM32 Target - Olimexino-STM32 F3 algorithm/Sytem information" /begin SUB_GROUP S8_Get_CPU_load1 S8_Get_free_Heap1 S8_Get_free_Stack1 /end SUB_GROUP /end GROUP
/begin GROUP S7_Algorithm "HANcoder_Olimexino_F3_ACC/HANcoder STM32 Target - Olimexino-STM32 F3 algorithm/Subsystem/Algorithm" /begin SUB_GROUP S11_Model_And_Control /end SUB_GROUP /end GROUP
/begin GROUP S7_Inputs "HANcoder_Olimexino_F3_ACC/HANcoder STM32 Target - Olimexino-STM32 F3 algorithm/Subsystem/Inputs" /begin SUB_GROUP S12_CAN_receive_LAPTOP /end SUB_GROUP /begin REF_MEASUREMENT Sim_GAP Sim_dist own_dist speed_Right /end REF_MEASUREMENT /end GROUP
/begin GROUP S8_Get_CPU_load1 "HANcoder_Olimexino_F3_ACC/HANcoder STM32 Target - Olimexino-STM32 F3 algorithm/Sytem information/Get CPU load1" /begin REF_MEASUREMENT SI_CPUload /end REF_MEASUREMENT /end GROUP
/begin GROUP S8_Get_free_Heap1 "HANcoder_Olimexino_F3_ACC/HANcoder STM32 Target - Olimexino-STM32 F3 algorithm/Sytem information/Get free Heap1" /begin REF_MEASUREMENT SI_FreeHeap /end REF_MEASUREMENT /end GROUP
/begin GROUP S8_Get_free_Stack1 "HANcoder_Olimexino_F3_ACC/HANcoder STM32 Target - Olimexino-STM32 F3 algorithm/Sytem information/Get free Stack1" /begin REF_MEASUREMENT SI_FreeStack /end REF_MEASUREMENT /end GROUP
/begin GROUP S11_Model_And_Control "HANcoder_Olimexino_F3_ACC/HANcoder STM32 Target - Olimexino-STM32 F3 algorithm/Subsystem/Algorithm/Model And Control"
 /begin SUB_GROUP S14_Distance_control S14_Speed_Feedback_Control S14_Switcher /end SUB_GROUP
 /begin REF_MEASUREMENT Speed_setpoint switcher /end REF_MEASUREMENT
/end GROUP
/begin GROUP S12_CAN_receive_LAPTOP "HANcoder_Olimexino_F3_ACC/HANcoder STM32 Target - Olimexino-STM32 F3 algorithm/Subsystem/Inputs/CAN receive LAPTOP" /begin SUB_GROUP S126_Enabled_Subsystem /end SUB_GROUP /end GROUP
/begin GROUP S14_Distance_control "HANcoder_Olimexino_F3_ACC/HANcoder STM32 Target - Olimexino-STM32 F3 algorithm/Subsystem/Algorithm/Model And Control/Distance control" /begin REF_MEASUREMENT E /end REF_MEASUREMENT /end GROUP
/begin GROUP S14_Speed_Feedback_Control "HANcoder_Olimexino_F3_ACC/HANcoder STM32 Target - Olimexino-STM32 F3 algorithm/Subsystem/Algorithm/Model And Control/Speed Feedback Control" /begin REF_MEASUREMENT control_effort /end REF_MEASUREMENT /end GROUP
/begin GROUP S14_Switcher "HANcoder_Olimexino_F3_ACC/HANcoder STM32 Target - Olimexino-STM32 F3 algorithm/Subsystem/Algorithm/Model And Control/Switcher" /begin REF_MEASUREMENT cc_acc_switcher /end REF_MEASUREMENT /end GROUP
/begin GROUP S126_Enabled_Subsystem "HANcoder_Olimexino_F3_ACC/HANcoder STM32 Target - Olimexino-STM32 F3 algorithm/Subsystem/Inputs/CAN receive LAPTOP/Enabled Subsystem" /begin REF_MEASUREMENT Distance_setpoint camera_gap gap_valid speed_setpoint /end REF_MEASUREMENT /end GROUP
/end MODULE
/end PROJECT
/* (add any file trailer comments here) */
/* EOF HANcoder_Olimexino_F3_ACC.a2l */
